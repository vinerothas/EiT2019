#include "TelenorNBIoT.h"
#include "Arduino.h"

#ifdef SERIAL_PORT_HARDWARE_OPEN

#define ublox SERIAL_PORT_HARDWARE_OPEN
#else

#include <SoftwareSerial.h>
SoftwareSerial ublox(5, 6);
#endif

TelenorNBIoT nbiot("mda.ee", 242, 01);

IPAddress remoteIP(172, 16, 15, 14);
int REMOTE_PORT = 1234;

unsigned long long tmp;
char buf[16];
char databuf[32];
uint16_t tmplen = 32;

void sending_setup(){
  while (!Serial) ;
  ublox.begin(9600);
  nbiot.begin(ublox);
  delay(1000);
  if (nbiot.createSocket()) {
    Serial.println(F("Created socket"));
  } else {
    Serial.println(F("Unable to create socket"));
  }

}

void sendData(String data){
  if (nbiot.sendString(remoteIP, REMOTE_PORT, data)) {
    Serial.println(F("Data sent"));
  } else {
    Serial.println(F("Unable to send data"));
  }
}